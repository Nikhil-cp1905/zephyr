## build/Kconfig/arch/Kconfig
```kconfig
# Load Zephyr Arch Kconfig descriptions.
osource "/home/nikhil/zephyrproject/zephyr/arch/x86/Kconfig"
osource "/home/nikhil/zephyrproject/zephyr/arch/xtensa/Kconfig"
osource "/home/nikhil/zephyrproject/zephyr/arch/sparc/Kconfig"
osource "/home/nikhil/zephyrproject/zephyr/arch/riscv/Kconfig"
osource "/home/nikhil/zephyrproject/zephyr/arch/posix/Kconfig"
osource "/home/nikhil/zephyrproject/zephyr/arch/nios2/Kconfig"
osource "/home/nikhil/zephyrproject/zephyr/arch/mips/Kconfig"
osource "/home/nikhil/zephyrproject/zephyr/arch/arm64/Kconfig"
osource "/home/nikhil/zephyrproject/zephyr/arch/arm/Kconfig"
osource "/home/nikhil/zephyrproject/zephyr/arch/arc/Kconfig"
```

## build/Kconfig/boards/Kconfig.defconfig
```kconfig
# Load Zephyr board defconfig descriptions.
osource "/home/nikhil/zephyrproject/zephyr/boards/st/nucleo_h7a3zi_q/Kconfig.defconfig"
```

## build/Kconfig/boards/Kconfig.nucleo_h7a3zi_q
```kconfig
# Load board Kconfig descriptions.
osource "/home/nikhil/zephyrproject/zephyr/boards/st/nucleo_h7a3zi_q/Kconfig.nucleo_h7a3zi_q"
```
